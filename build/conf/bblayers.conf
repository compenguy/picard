## build/conf/bblayers.conf
```bitbake
# LAYER_CONF_VERSION is increased each time build/conf/bblayers.conf
# changes incompatibly
LCONF_VERSION = "7"

BBPATH = "${TOPDIR}"
BBFILES ?= ""

BBLAYERS ?= " \
  ${TOPDIR}/../source/openembedded-core/meta \
  ${TOPDIR}/../source/meta-openembedded/meta-oe \
  ${TOPDIR}/../source/meta-openembedded/meta-python \
  ${TOPDIR}/../source/meta-raspberrypi \
  ${TOPDIR}/../source/meta-rust \
  ${TOPDIR}/../source/meta-picard \
  "
```
